## buildroot/configs/annotator_defconfig
```kconfig
# ── Architecture ──────────────────────────────────────────────────────────────
BR2_x86_64=y

# ── Toolchain ─────────────────────────────────────────────────────────────────
BR2_PACKAGE_HOST_LINUX_HEADERS_CUSTOM_6_6=y
BR2_TOOLCHAIN_BUILDROOT_GLIBC=y
BR2_TOOLCHAIN_BUILDROOT_CXX=y

# ── System ────────────────────────────────────────────────────────────────────
BR2_TARGET_GENERIC_HOSTNAME="annotator"
BR2_TARGET_GENERIC_ISSUE="Annotator"
BR2_SYSTEM_DHCP=""
BR2_TARGET_ROOTFS_COMMON_SQUASHFS_LZMA=y
BR2_ROOTFS_OVERLAY="$(BR2_EXTERNAL_ANNOTATOR_PATH)/board/annotator/rootfs_overlay"

# Run X + annotator automatically on tty1 as root
BR2_SYSTEM_DEFAULT_PATH="/bin:/sbin:/usr/bin:/usr/sbin"

# ── Kernel ────────────────────────────────────────────────────────────────────
BR2_LINUX_KERNEL=y
BR2_LINUX_KERNEL_CUSTOM_VERSION=y
BR2_LINUX_KERNEL_CUSTOM_VERSION_VALUE="6.6.87"
BR2_LINUX_KERNEL_USE_CUSTOM_CONFIG=y
BR2_LINUX_KERNEL_CUSTOM_CONFIG_FILE="$(BR2_EXTERNAL_ANNOTATOR_PATH)/board/annotator/linux.config"
BR2_LINUX_KERNEL_NEEDS_HOST_LIBELF=y

# ── Bootloader: GRUB2 EFI (x86_64-efi, OVMF) ───────────────────────────────
BR2_TARGET_GRUB2=y
BR2_TARGET_GRUB2_X86_64_EFI=y
BR2_TARGET_GRUB2_BUILTIN_MODULES_EFI="boot linux iso9660 normal"
BR2_TARGET_GRUB2_BUILTIN_CONFIG_EFI="$(BR2_EXTERNAL_ANNOTATOR_PATH)/board/annotator/grub-efi-builtin.cfg"

# ── Filesystem: ISO image with initrd ─────────────────────────────────────────
BR2_TARGET_ROOTFS_CPIO=y
BR2_TARGET_ROOTFS_CPIO_GZIP=y
BR2_TARGET_ROOTFS_ISO9660=y
BR2_TARGET_ROOTFS_ISO9660_GRUB2=y
BR2_TARGET_ROOTFS_ISO9660_INITRD=y
BR2_TARGET_ROOTFS_ISO9660_BOOT_MENU="$(BR2_EXTERNAL_ANNOTATOR_PATH)/board/annotator/grub.cfg"
# BR2_TARGET_ROOTFS_TAR is not set
# BR2_TARGET_ROOTFS_EXT2 is not set

# ── Device management (udev) ─────────────────────────────────────────────────
# Required by xf86-input-evdev and xf86-input-libinput (depend on BR2_PACKAGE_HAS_UDEV)
# EUDEV uses devtmpfs + udev rules for /dev population
BR2_ROOTFS_DEVICE_CREATION_DYNAMIC_EUDEV=y

# ── X.Org server ──────────────────────────────────────────────────────────────
BR2_PACKAGE_XORG7=y
BR2_PACKAGE_XSERVER_XORG_SERVER=y
BR2_PACKAGE_XAPP_XINIT=y
# xauth is called by startx/xinit to manage .Xauthority cookies
BR2_PACKAGE_XAPP_XAUTH=y

# Input drivers — evdev (explicit device binding) + libinput (auto-detection)
# Note: xf86-input-mouse was removed upstream in 2.0.0; use evdev/libinput instead.
BR2_PACKAGE_XDRIVER_XF86_INPUT_EVDEV=y
BR2_PACKAGE_XDRIVER_XF86_INPUT_LIBINPUT=y

# Video driver — intel (i915) + VESA fallback (covers QEMU std VGA)
BR2_PACKAGE_XDRIVER_XF86_VIDEO_INTEL=y
BR2_PACKAGE_XDRIVER_XF86_VIDEO_VESA=y
BR2_PACKAGE_XDRIVER_XF86_VIDEO_FBDEV=y

# Keyboard layout data — without this X cannot configure any keyboard
BR2_PACKAGE_XKEYBOARD_CONFIG=y

# ── Cursor font + theme (without this X11 renders an invisible cursor) ────────
BR2_PACKAGE_XFONT_CURSOR_MISC=y
BR2_PACKAGE_XCURSOR_THEMES=y

# ── SDL2 ──────────────────────────────────────────────────────────────────────
BR2_PACKAGE_SDL2=y
BR2_PACKAGE_SDL2_X11=y
BR2_PACKAGE_SDL2_TTF=y

# ── Annotator app ─────────────────────────────────────────────────────────────
BR2_PACKAGE_ANNOTATOR=y

# ── No network stack at runtime ───────────────────────────────────────────────
# (network is only needed in build.rs at compile time, not at runtime)
# The annotator binary is pre-compiled by build.rs and injected via
# ANNOTATOR_PREBUILT_BIN, so host Rust is not needed inside buildroot.
```

## buildroot/package/annotator/Config.in
```kconfig
config BR2_PACKAGE_ANNOTATOR
	bool "annotator"
	depends on BR2_PACKAGE_SDL2
	depends on BR2_PACKAGE_SDL2_TTF
	help
	  Court annotation overlay application.
	  Requires SDL2, SDL2_ttf, and V4L2 kernel support.
```
